## CMakeLists.txt
```
# SPDX-License-Identifier: Apache-2.0

cmake_minimum_required(VERSION 3.20.0)

# list(APPEND CONF_FILE
#   ${CMAKE_CURRENT_SOURCE_DIR}/nrf52840dongle_nrf52840.conf)

find_package(Zephyr REQUIRED HINTS $ENV{ZEPHYR_BASE})
project(slimevr-central)

target_sources(app PRIVATE
  src/main.c
  src/connectionManager.c
  src/echo_server.c
  src/udp.c
  src/usb.c
)

zephyr_library_include_directories(${CMAKE_CURRENT_SOURCE_DIR}/include)
```

## prj.conf
```kconfig
CONFIG_BT=y
CONFIG_BT_CENTRAL=y
CONFIG_BT_SCAN=y
CONFIG_BT_SCAN_FILTER_ENABLE=y
CONFIG_BT_SCAN_UUID_CNT=1
CONFIG_BT_GATT_CLIENT=y
# CONFIG_BT_GATT_AUTO_DISCOVER_CCC=y
# CONFIG_BT_GATT_AUTO_RESUBSCRIBE=y
# CONFIG_BT_GATT_AUTO_UPDATE_MTU=y
CONFIG_BT_GATT_DM=y
# CONFIG_BT_GATT_DM_DATA_PRINT=y
CONFIG_HEAP_MEM_POOL_SIZE=1024
CONFIG_MAIN_STACK_SIZE=2048
CONFIG_BT_RX_STACK_SIZE=1024
CONFIG_SYSTEM_WORKQUEUE_STACK_SIZE=2048
CONFIG_ISR_STACK_SIZE=2048

# CONFIG_ASSERT=y
# CONFIG_LOG=y # This option stops the disconnect callback from ever happening?????????????
# CONFIG_THREAD_NAME=y
CONFIG_RESET_ON_FATAL_ERROR=n

CONFIG_BT_CTLR_PHY_2M=y
CONFIG_BT_PHY_UPDATE=y
CONFIG_BT_AUTO_PHY_UPDATE=n
CONFIG_BT_USER_PHY_UPDATE=y
CONFIG_BT_USER_DATA_LEN_UPDATE=y

#This is the maximum data length with Nordic Softdevice controller
CONFIG_BT_CTLR_DATA_LENGTH_MAX=251
#These buffers are needed for the data length max. 
CONFIG_BT_BUF_ACL_TX_SIZE=251
CONFIG_BT_BUF_ACL_RX_SIZE=251
#This is the maximum MTU size with Nordic Softdevice controller
CONFIG_BT_L2CAP_TX_MTU=247

## This option severely impacts RAM
CONFIG_BT_MAX_CONN=11

CONFIG_INIT_STACKS=y
CONFIG_TEST_RANDOM_GENERATOR=y

CONFIG_USB_DEVICE_PRODUCT="Zephyr USB console sample"
CONFIG_USB_DEVICE_PID=0x0004
CONFIG_SERIAL=y
CONFIG_CONSOLE=y
CONFIG_UART_LINE_CTRL=y
CONFIG_USB_CDC_ACM=y
CONFIG_SERIAL=y
CONFIG_STDOUT_CONSOLE=y
CONFIG_UART_LINE_CTRL=y
CONFIG_USB_COMPOSITE_DEVICE=y
CONFIG_USB_DEVICE_OS_DESC=y
CONFIG_USB_DEVICE_INITIALIZE_AT_BOOT=n

CONFIG_USE_SEGGER_RTT=y
# CONFIG_RTT_CONSOLE=y
# CONFIG_RTT_CONSOLE=y
CONFIG_LOG=y
CONFIG_LOG_BACKEND_RTT=y
CONFIG_LOG_DEFAULT_LEVEL=3

# CONFIG_USB_DEVICE_BLUETOOTH=y
CONFIG_USB_DEVICE_LOOPBACK=y
CONFIG_USB_NRFX=y
CONFIG_USB_DEVICE_MANUFACTURER="Test"
CONFIG_BOOTLOADER_BOSSA=y
CONFIG_BOOTLOADER_BOSSA_ADAFRUIT_UF2=y

CONFIG_BOOT_DELAY=3000

## NETUSB
# # USB Device Settings
CONFIG_USB_DEVICE_STACK=y
# # Select USB Configurations
CONFIG_USB_DEVICE_NETWORK_ECM=y
# CONFIG_USB_DEVICE_INITIALIZE_AT_BOOT=n

## LOOPBACK
CONFIG_NET_DRIVERS=y
CONFIG_NET_LOOPBACK=y
CONFIG_NET_LOOPBACK_MTU=1100
# Enable for testing TX only
# CONFIG_NET_LOOPBACK_SIMULATE_PACKET_DROP=y
CONFIG_NET_BUF_DATA_SIZE=1100
# Optimized networking settings for performance
CONFIG_NET_PKT_RX_COUNT=32
CONFIG_NET_PKT_TX_COUNT=48
CONFIG_NET_BUF_RX_COUNT=32
# was 96
CONFIG_NET_BUF_TX_COUNT=64

CONFIG_NETWORKING=y
CONFIG_NET_IPV6=n
CONFIG_NET_IPV4=y
CONFIG_NET_ARP=y
CONFIG_NET_DHCPV4=y
CONFIG_NET_DHCPV4_OPTION_CALLBACKS=y
CONFIG_DNS_RESOLVER=y
CONFIG_NET_UDP=y
CONFIG_NET_TCP=y
CONFIG_NET_STATISTICS=y
CONFIG_ENTROPY_GENERATOR=y
CONFIG_MDNS_RESOLVER=y

CONFIG_NET_MGMT=y
CONFIG_NET_MGMT_EVENT=y

CONFIG_NET_LOG=y
CONFIG_LOG=y

# CONFIG_NET_BUF_DATA_SIZE=1500
CONFIG_NET_MAX_CONTEXTS=5
CONFIG_NET_TC_TX_COUNT=1
CONFIG_NET_SOCKETS=y
CONFIG_NET_SOCKETS_POSIX_NAMES=y
CONFIG_NET_SOCKETS_POLL_MAX=4
CONFIG_POSIX_MAX_FDS=8

CONFIG_DNS_RESOLVER=y

CONFIG_INIT_STACKS=y
CONFIG_TEST_RANDOM_GENERATOR=y


CONFIG_NET_L2_ETHERNET=y
CONFIG_NET_SHELL=y

# CONFIG_NET_CONFIG_SETTINGS=y
# CONFIG_NET_CONFIG_MY_IPV6_ADDR="2001:db8::1"
# CONFIG_NET_CONFIG_PEER_IPV6_ADDR="2001:db8::2"
# CONFIG_NET_CONFIG_MY_IPV4_ADDR="192.0.2.1"
# CONFIG_NET_CONFIG_PEER_IPV4_ADDR="192.0.2.2"

# CONFIG_SHELL_CMDS_RESIZE=n

# USB DFU
# CONFIG_FLASH_MAP=y
# CONFIG_MCUBOOT_IMG_MANAGER=y
# CONFIG_FLASH=y
# CONFIG_STREAM_FLASH=y
# CONFIG_IMG_MANAGER=y
# CONFIG_USB_DFU_CLASS=y

CONFIG_LOG=y
CONFIG_NET_LOG=y
CONFIG_NET_TCP_LOG_LEVEL_DBG=y
# CONFIG_NET_CAPTURE=y
CONFIG_NET_IF_MAX_IPV4_COUNT=10
CONFIG_NET_IF_UNICAST_IPV4_ADDR_COUNT=2
CONFIG_NET_CONFIG_AUTO_INIT=y
CONFIG_NET_CONFIG_NEED_IPV4=y
# CONFIG_NET_CONFIG_MY_IPV4_ADDR="192.168.11.111"
# CONFIG_NET_CONFIG_PEER_IPV4_ADDR="192.168.11.100"
# CONFIG_NET_CONFIG_MY_IPV4_GW="192.168.11.1"

# enable fragmenting
CONFIG_NET_IPV4_FRAGMENT=y
CONFIG_NET_IPV4_FRAGMENT_MAX_COUNT=16
CONFIG_NET_IPV4_FRAGMENT_TIMEOUT=15
CONFIG_NET_IPV4_FRAGMENT_MAX_PKT=8

# CONFIG_NET_MGMT_EVENT_STACK_SIZE=8192
# CONFIG_PRIVILEGED_STACK_SIZE=8192
# CONFIG_NET_TX_STACK_SIZE=8192
# CONFIG_NET_RX_STACK_SIZE=8192
# CONFIG_SYSTEM_WORKQUEUE_STACK_SIZE=8192
# CONFIG_MAIN_STACK_SIZE=8192
# CONFIG_IDLE_STACK_SIZE=8192
# CONFIG_ISR_STACK_SIZE=8192
# CONFIG_LOG_PROCESS_THREAD_STACK_SIZE=8192
# CONFIG_NET_CONNECTION_MANAGER_MONITOR_STACK_SIZE=8192
# CONFIG_SHELL_STACK_SIZE=8192

CONFIG_NET_CONFIG_SETTINGS=y

# CONFIG_POSIX_API=y
CONFIG_NET_CONNECTION_MANAGER=y

CONFIG_PRINTK=y

# Network buffers
CONFIG_NET_CONTEXT_NET_PKT_POOL=y
CONFIG_SHELL=y

# Number of socket descriptors might need adjusting
# if there are more than 1 handlers defined.
# CONFIG_ZVFS_OPEN_MAX=12

# How many client can connect to echo-server simultaneously
# CONFIG_NET_SAMPLE_NUM_HANDLERS=1

CONFIG_POSIX_API=n
CONFIG_NET_SOCKETS_POSIX_NAMES=y
```

## nrf52840dk_nrf52840.overlay
```dts
// &uart0 {
//     current-speed = <1000000>;
// };
```

## boards/xiao_ble.overlay
```dts
/* SPDX-License-Identifier: Apache-2.0 */

/*
 * Copyright (c) 2021 Nordic Semiconductor ASA
 *
 * SPDX-License-Identifier: Apache-2.0
 */

//  / {
// 	chosen {
// 		zephyr,console = &cdc_acm_uart0;
// 	};
// };

// &zephyr_udc0 {
// 	cdc_acm_uart0: cdc_acm_uart0 {
// 		compatible = "zephyr,cdc-acm-uart";
// 	};
// };
```

## src/main.c
```c
/* main.c - Application main entry point */

/*
 * Copyright (c) 2015-2016 Intel Corporation
 *
 * SPDX-License-Identifier: Apache-2.0
 */

#include <zephyr/types.h>
#include <stddef.h>
#include <errno.h>
#include <zephyr/kernel.h>
#include <zephyr/sys/printk.h>

#include <zephyr/bluetooth/bluetooth.h>
#include <zephyr/bluetooth/hci.h>
#include <zephyr/bluetooth/conn.h>
#include <zephyr/bluetooth/uuid.h>
#include <zephyr/bluetooth/gatt.h>
#include <bluetooth/scan.h>
#include <bluetooth/gatt_dm.h>
#include <zephyr/sys/byteorder.h>
#include <zephyr/drivers/gpio.h>
#include <nrf52840.h>

#include <zephyr/net/loopback.h>
#include <zephyr/logging/log.h>
#include "echo_server.h"

LOG_MODULE_REGISTER(foo, LOG_LEVEL_ERR);

#include "connectionManager.h"

#define BOOTLOADER_MAGIC_VALUE (0xf01669ef)

#define ADDR_LEN BT_ADDR_LE_STR_LEN

static void start_scan(void);
static bool stop_scan();

#define UUID_SLIME_VR_VAL BT_UUID_128_ENCODE(0x677abafc, 0x4bd7, 0xcfa8, 0x014e, 0xbb1444f02608)
#define UUID_SLIME_VR BT_UUID_DECLARE_128(UUID_SLIME_VR_VAL)
#define UUID_SLIME_VR_CHR_VAL BT_UUID_128_ENCODE(0x6fd1aa9d, 0xd1da, 0xca9f, 0x144b, 0x8118aaae7c9d)
#define UUID_SLIME_VR_CHR BT_UUID_DECLARE_128(UUID_SLIME_VR_CHR_VAL)

CONNECTION_MAP_INIT(connections, 6)

int current_connection_index = -1;

int slimevr_send(struct bt_conn *conn, const uint8_t *data, uint16_t length);

bool ad_decode(struct bt_data *data, void *user_data)
{
	switch(data->type)
	{
		case BT_DATA_UUID128_ALL:
			for(int i = 0; i < data->data_len; i++)
			{
				printk("%x", data->data[i]);
			}
			
			return true;
		case BT_DATA_NAME_COMPLETE:
			printk("%s\n", data->data);
			
			return true;
		default: 
	}

	return false;
}

void scan_filter_match(struct bt_scan_device_info *device_info,
			     struct bt_scan_filter_match *filter_match,
			     bool connectable)
{
	char addr_str[BT_ADDR_LE_STR_LEN];
	int err;

	if(cm_get_next_free_object_index(&connections) < 0)
	{
		printk("Too many devices connected\n");
		return;
	}

	bt_addr_le_to_str(device_info->recv_info->addr, addr_str, sizeof(addr_str));
	printk("Device found: %s (RSSI %d)\n", addr_str, device_info->recv_info->rssi);

	bt_data_parse(device_info->adv_data, ad_decode, NULL);

	if (stop_scan()) {
		return;
	}

	current_connection_index = cm_get_next_free_object_index(&connections);
	if(current_connection_index < 0)
	{
		return;
	}

	memcpy(connections.entry[current_connection_index].addr, addr_str, BT_ADDR_LE_STR_LEN); 
	err = bt_conn_le_create(device_info->recv_info->addr, BT_CONN_LE_CREATE_CONN,
				BT_LE_CONN_PARAM_DEFAULT, &connections.entry[current_connection_index].connection);
	if (err) {
		printk("Create conn to %s failed (%d)\n", addr_str, err);
		start_scan();
	}
}

void scan_filter_no_match(struct bt_scan_device_info *device_info,
				bool connectable)
{
	// for(int i = 0; i < device_info->adv_data->len; i++)
	// {
	// 	printk("%c", device_info->adv_data->data[i]);
	// }	

	// printk("\n");
}

BT_SCAN_CB_INIT(scan_cb, scan_filter_match, scan_filter_no_match, NULL, NULL);

bool already_scanning = false;

static void start_scan(void)
{
	int err;

	if(already_scanning)
	{
		return;
	}

	/* This demo doesn't require active scan */
	err = bt_le_scan_start(BT_LE_SCAN_ACTIVE, NULL);
	if (err) {
		printk("Scanning failed to start (err %d)\n", err);
		return;
	}

	printk("Scanning successfully started\n");

	already_scanning = true;
}

static bool stop_scan()
{
	bool err = bt_le_scan_stop();

	if(err)
	{
		return err;
	}

	already_scanning = false;

	return err;
}

uint64_t count_messages = 0;
int64_t timer = 0;

static uint8_t on_received(struct bt_conn *conn,
			struct bt_gatt_subscribe_params *params,
			const void *data, uint16_t length)
{
	int index = cm_get_index_with_conn(&connections, conn);
	connections.entry[index].debug_counter++;
	connections.entry[index].debug_data_counter += length;

	if(k_uptime_get() <= timer + 1000)
	{
		return BT_GATT_ITER_CONTINUE;
	}

	timer = k_uptime_get();
	printk("=======================================\n");
	for(int i = 0; i < connections.size; i++)
	{
		if(connections.entry[i].connection == NULL)
		{
			continue;
		}

		printk("Messages from (%s): %llu (%llu Bytes)\n", connections.entry[i].addr, connections.entry[i].debug_counter, connections.entry[i].debug_data_counter);
		connections.entry[i].debug_counter = 0;
		connections.entry[i].debug_data_counter = 0;
	}
	printk("=======================================\n");


	// uint8_t *data_ptr = (uint8_t *) data;
	// for(int i = 0; i < length; i++)
	// {
	// 	printk("%x", data_ptr[i]);
	// }
	// printk("\n");

	return BT_GATT_ITER_CONTINUE;
}

int slimevr_handles_get(struct bt_gatt_dm *dm)
{
	// char uuid_str[37];

	const struct bt_gatt_dm_attr *gatt_chrc_attr = 
		bt_gatt_dm_char_by_uuid(dm, UUID_SLIME_VR_CHR);
	const struct bt_gatt_chrc *gatt_chrc = 
		bt_gatt_dm_attr_chrc_val(gatt_chrc_attr);
	
	char addr[ADDR_LEN];
	bt_addr_le_to_str(bt_conn_get_dst(bt_gatt_dm_conn_get(dm)), addr, ADDR_LEN);
	int index = cm_get_index_with_addr(&connections, addr);

	connections.entry[index].write_params.handle = gatt_chrc->value_handle;

	// bt_uuid_to_str(gatt_chrc->uuid, uuid_str, sizeof(uuid_str));
	// printk("CHRC: %s\n", uuid_str);

	return 0;
}

struct bt_gatt_subscribe_params sub_params;

void on_subscribed(struct bt_conn *conn, uint8_t err,
					 struct bt_gatt_subscribe_params *params)
{
	char handshake_part[] = "Hey OVR =D 5";

	char handshake[sizeof(handshake_part) + 1];

	handshake[0] = 3;
	memcpy(handshake + 1, handshake_part, sizeof(handshake_part));

	slimevr_send(conn, (const uint8_t *)handshake, sizeof(handshake));
}

int slimevr_subscribe(struct bt_gatt_dm *dm)
{
	char addr[ADDR_LEN];
	bt_addr_le_to_str(bt_conn_get_dst(bt_gatt_dm_conn_get(dm)), addr, ADDR_LEN);
	int index = cm_get_index_with_addr(&connections, addr);
	
	connections.entry[index].sub_params.subscribe = on_subscribed;
	connections.entry[index].sub_params.notify = on_received;
	connections.entry[index].sub_params.value = BT_GATT_CCC_NOTIFY;

	const struct bt_gatt_dm_attr *gatt_chrc_attr = 
		bt_gatt_dm_char_by_uuid(dm, UUID_SLIME_VR_CHR);
	
	const struct bt_gatt_dm_attr *gatt_desc;

	gatt_desc = bt_gatt_dm_desc_by_uuid(dm, gatt_chrc_attr, UUID_SLIME_VR_CHR);

	connections.entry[index].sub_params.value_handle = gatt_desc->handle;

	gatt_desc = bt_gatt_dm_desc_by_uuid(dm, gatt_chrc_attr, BT_UUID_GATT_CCC);

	connections.entry[index].sub_params.ccc_handle = gatt_desc->handle;

	return bt_gatt_subscribe(bt_gatt_dm_conn_get(dm), &connections.entry[index].sub_params);
}

static void discover_all_completed(struct bt_gatt_dm *dm, void *ctx)
{
	char uuid_str[37];

	const struct bt_gatt_dm_attr *gatt_service_attr =
			bt_gatt_dm_service_get(dm);
	const struct bt_gatt_service_val *gatt_service =
			bt_gatt_dm_attr_service_val(gatt_service_attr);

	size_t attr_count = bt_gatt_dm_attr_cnt(dm);

	bt_uuid_to_str(gatt_service->uuid, uuid_str, sizeof(uuid_str));
	printk("Found service %s\n", uuid_str);
	printk("Attribute count: %d\n", attr_count);

	slimevr_handles_get(dm);
	slimevr_subscribe(dm);
	// bt_gatt_dm_data_print(dm);
	bt_gatt_dm_data_release(dm);
	bt_gatt_dm_continue(dm, NULL);
}

void on_write(struct bt_conn *conn, uint8_t err,
				     struct bt_gatt_write_params *params)
{
	printk("Written\n");
	start_scan();
}

int slimevr_send(struct bt_conn *conn, const uint8_t *data, uint16_t length)
{
	int index = cm_get_index_with_conn(&connections, conn);

	connections.entry[index].write_params.func = on_write;
	connections.entry[index].write_params.offset = 0;
	connections.entry[index].write_params.data = data;
	connections.entry[index].write_params.length = length;

	return bt_gatt_write(conn, &connections.entry[index].write_params);
}

static void discover_all_service_not_found(struct bt_conn *conn, void *ctx)
{
	printk("No more services\n");
}

static void discover_all_error_found(struct bt_conn *conn, int err, void *ctx)
{
	printk("The discovery procedure failed, err %d\n", err);
}

static struct bt_gatt_dm_cb discover_all_cb = {
	.completed = discover_all_completed,
	.service_not_found = discover_all_service_not_found,
	.error_found = discover_all_error_found,
};

void mtu_exchange_func(struct bt_conn *conn, uint8_t err,
		     struct bt_gatt_exchange_params *params)
{
	printk("MTU Exchanged: %d\n", err);

	printk("MTU: %u\n", bt_gatt_get_mtu(conn));
}

struct bt_gatt_exchange_params exchange_params = {
		.func = mtu_exchange_func
};

struct bt_le_conn_param conn_param = {
	.interval_max = 6,
	.interval_min = 6,
	.latency = 0,
	.timeout = 10
};

static void connected(struct bt_conn *conn, uint8_t err)
{
	char addr[BT_ADDR_LE_STR_LEN];

	bt_addr_le_to_str(bt_conn_get_dst(conn), addr, sizeof(addr));

	if (err) {
		printk("Failed to connect to %s (%u)\n", addr, err);

		bt_conn_unref(connections.entry[current_connection_index].connection);
		connections.entry[current_connection_index].connection = NULL;

		start_scan();
		return;
	}

	if (conn != connections.entry[current_connection_index].connection) {
		return;
	}

	printk("Connected: %s\n", addr);

	bt_gatt_exchange_mtu(conn, &exchange_params);

	printk("Updated phy?: %d\n", bt_conn_le_phy_update(conn, BT_CONN_LE_PHY_PARAM_2M));

	printk("Updated params?: %d\n", bt_conn_le_param_update(conn, &conn_param));

	printk("Updated len?: %d\n", bt_conn_le_data_len_update(conn, BT_LE_DATA_LEN_PARAM_MAX));

	err = bt_gatt_dm_start(conn, UUID_SLIME_VR, &discover_all_cb, NULL);
	if (err) {
		printk("Failed to start discovery (err %d)\n", err);
	}
}

static void disconnected(struct bt_conn *conn, uint8_t reason)
{
	char addr[BT_ADDR_LE_STR_LEN];

	bt_addr_le_to_str(bt_conn_get_dst(conn), addr, sizeof(addr));

	int index = cm_get_index_with_addr(&connections, addr);

	if (conn != connections.entry[index].connection) {
		return;
	}

	printk("Disconnected: %s (reason 0x%02x)\n", addr, reason);

	bt_conn_unref(connections.entry[index].connection);
	connections.entry[index].connection = NULL;

	start_scan();
}

struct bt_conn_cb conn_callbacks = {
	.connected = connected,
	.disconnected = disconnected,
};

struct bt_scan_init_param scan_init = {
		.connect_if_match = 0,
		.scan_param = BT_LE_SCAN_ACTIVE,
		.conn_param = BT_LE_CONN_PARAM_DEFAULT
	};


#include <zephyr/kernel.h>
#include <zephyr/sys/printk.h>
#include <zephyr/usb/usb_device.h>
#include <zephyr/usb/usbd.h>
#include <zephyr/drivers/uart.h>
#include <zephyr/logging/log.h>

#include <zephyr/net/net_if.h>
#include <zephyr/net/net_core.h>
#include <zephyr/net/net_context.h>
#include <zephyr/net/net_mgmt.h>
#include <zephyr/net/dns_resolve.h>

#define DHCP_OPTION_NTP (42)

static uint8_t ntp_server[4];

static struct net_mgmt_event_callback mgmt_cb;

static struct net_dhcpv4_option_callback dhcp_cb;

static void start_dhcpv4_client(struct net_if *iface, void *user_data)
{
	ARG_UNUSED(user_data);

	// LOG_INF("Start on %s: index=%d", net_if_get_device(iface)->name,
	// 	net_if_get_by_iface(iface));
	net_dhcpv4_start(iface);
}

static void handler(struct net_mgmt_event_callback *cb,
		    uint32_t mgmt_event,
		    struct net_if *iface)
{
	int i = 0;

	if (mgmt_event != NET_EVENT_IPV4_ADDR_ADD) {
		return;
	}

	for (i = 0; i < NET_IF_MAX_IPV4_ADDR; i++) {
		char buf[NET_IPV4_ADDR_LEN];

		if (iface->config.ip.ipv4->unicast[i].addr_type !=
							NET_ADDR_DHCP) {
			continue;
		}

		LOG_INF("   Address[%d]: %s", net_if_get_by_iface(iface),
			net_addr_ntop(AF_INET,
			    &iface->config.ip.ipv4->unicast[i].address.in_addr,
						  buf, sizeof(buf)));
		LOG_INF("    Subnet[%d]: %s", net_if_get_by_iface(iface),
			net_addr_ntop(AF_INET,
				       &iface->config.ip.ipv4->netmask,
				       buf, sizeof(buf)));
		LOG_INF("    Router[%d]: %s", net_if_get_by_iface(iface),
			net_addr_ntop(AF_INET,
						 &iface->config.ip.ipv4->gw,
						 buf, sizeof(buf)));
		LOG_INF("Lease time[%d]: %u seconds", net_if_get_by_iface(iface),
			iface->config.dhcpv4.lease_time);
	}
}

static void print_dhcpv4_addr(struct net_if *iface, struct net_if_addr *if_addr,
			      void *user_data)
{
	bool *found = (bool *)user_data;
	char hr_addr[NET_IPV4_ADDR_LEN];
	struct in_addr netmask;

	if (*found) {
		return;
	}

	if (if_addr->addr_type != NET_ADDR_DHCP) {
		return;
	}

	LOG_INF("IPv4 address: %s",
		net_addr_ntop(AF_INET, &if_addr->address.in_addr,
			      hr_addr, NET_IPV4_ADDR_LEN));
	LOG_INF("Lease time: %u seconds", iface->config.dhcpv4.lease_time);

	// netmask = net_if_ipv4_get_netmask_by_addr(iface,
	// 					  &if_addr->address.in_addr);
	// LOG_INF("Subnet: %s",
	// 	net_addr_ntop(AF_INET, &netmask, hr_addr, NET_IPV4_ADDR_LEN));
	// LOG_INF("Router: %s",
	// 	net_addr_ntop(AF_INET,
	// 		      &iface->config.ip.ipv4->gw,
	// 		      hr_addr, NET_IPV4_ADDR_LEN));

	*found = true;
}

static void option_handler(struct net_dhcpv4_option_callback *cb,
			   size_t length,
			   enum net_dhcpv4_msg_type msg_type,
			   struct net_if *iface)
{
	char buf[NET_IPV4_ADDR_LEN];

	LOG_INF("DHCP Option %d: %s", cb->option,
		net_addr_ntop(AF_INET, cb->data, buf, sizeof(buf)));
}

BUILD_ASSERT(DT_NODE_HAS_COMPAT(DT_CHOSEN(zephyr_console), zephyr_cdc_acm_uart),
	     "Console device is not ACM CDC UART device");

static const struct gpio_dt_spec led = GPIO_DT_SPEC_GET(DT_ALIAS(led0), gpios);

int main(void)
{
	int err;

	start_echo_server();

	if (!gpio_is_ready_dt(&led)) {
		// return 0;
	}

	err = gpio_pin_configure_dt(&led, GPIO_OUTPUT_ACTIVE);
	if (err < 0) {
		// return 0;
	}

	const struct device *const dev = DEVICE_DT_GET(DT_CHOSEN(zephyr_console));
	uint32_t dtr = 0;

	if (usb_enable(NULL)) {
		return 0;
	}

	net_mgmt_init_event_callback(&mgmt_cb, handler,
				     NET_EVENT_IPV4_ADDR_ADD);
	net_mgmt_add_event_callback(&mgmt_cb);

	net_dhcpv4_init_option_callback(&dhcp_cb, option_handler,
					DHCP_OPTION_NTP, ntp_server,
					sizeof(ntp_server));

	net_dhcpv4_add_option_callback(&dhcp_cb);

	net_if_foreach(start_dhcpv4_client, NULL);

	gpio_pin_set_dt(&led, 1);
	

	while(true)
	{
		LOG_ERR("HI");
		k_msleep(500);
	}

	return 0;

	// Don't know why this is enabled, but it stops device from working sometimes
	/* Poll if the DTR flag was set */
	while (!dtr) {
		uart_line_ctrl_get(dev, UART_LINE_CTRL_DTR, &dtr);
		/* Give CPU resources to low priority threads. */
		k_sleep(K_MSEC(100));
	}

	err = bt_enable(NULL);
	if (err) {
		printk("Bluetooth init failed (err %d)\n", err);
		return 0;
	}

	bt_conn_cb_register(&conn_callbacks);

	printk("Bluetooth initialized\n");
	k_msleep(1000);

	bt_scan_init(&scan_init);
	bt_scan_cb_register(&scan_cb);

	bt_scan_filter_add(BT_SCAN_FILTER_TYPE_UUID, UUID_SLIME_VR);

	bt_scan_filter_enable(BT_SCAN_UUID_FILTER, false);

	start_scan();

	// while(true)
	// {
	// 	printk("Test\r\n");
	// 	k_msleep(1000);
	// }
	

	return 0;
}
```

## include/common.h
```c
/*
 * Copyright (c) 2017-2019 Intel Corporation.
 * Copyright (c) 2018 Nordic Semiconductor ASA.
 *
 * SPDX-License-Identifier: Apache-2.0
 */


#define MY_PORT 4242
#if defined(CONFIG_NET_SOCKETS_SOCKOPT_TLS) || defined(CONFIG_NET_TCP) || \
	defined(CONFIG_COVERAGE_GCOV)
#define STACK_SIZE 4096
#else
#define STACK_SIZE 2048
#endif

#if defined(CONFIG_NET_TC_THREAD_COOPERATIVE)
#define THREAD_PRIORITY K_PRIO_COOP(CONFIG_NUM_COOP_PRIORITIES - 1)
#else
#define THREAD_PRIORITY K_PRIO_PREEMPT(8)
#endif

#define RECV_BUFFER_SIZE 1280
#define STATS_TIMER 60 /* How often to print statistics (in seconds) */

#if defined(CONFIG_USERSPACE)
#include <zephyr/app_memory/app_memdomain.h>
extern struct k_mem_partition app_partition;
extern struct k_mem_domain app_domain;
#define APP_BMEM K_APP_BMEM(app_partition)
#define APP_DMEM K_APP_DMEM(app_partition)
#else
#define APP_BMEM
#define APP_DMEM
#endif

struct data {
	const char *proto;

	struct {
		int sock;
		char recv_buffer[RECV_BUFFER_SIZE];
		uint32_t counter;
		atomic_t bytes_received;
		struct k_work_delayable stats_print;
	} udp;

	struct {
		int sock;
		atomic_t bytes_received;
		struct k_work_delayable stats_print;

		struct {
			int sock;
			char recv_buffer[RECV_BUFFER_SIZE];
			uint32_t counter;
		} accepted[1]; //CONFIG_NET_SAMPLE_NUM_HANDLERS
	} tcp;
};

struct configs {
	struct data ipv4;
	struct data ipv6;
};

extern struct configs conf;

void start_udp(void);
void stop_udp(void);

void start_tcp(void);
void stop_tcp(void);

void quit(void);

#if defined(CONFIG_NET_VLAN)
int init_vlan(void);
#else
static inline int init_vlan(void)
{
	return 0;
}
#endif /* CONFIG_NET_VLAN */

#if defined(CONFIG_NET_L2_IPIP)
int init_tunnel(void);
bool is_tunnel(struct net_if *iface);
#else
static inline int init_tunnel(void)
{
	return 0;
}

static inline bool is_tunnel(struct net_if *iface)
{
	ARG_UNUSED(iface);
	return false;
}
#endif /* CONFIG_NET_L2_IPIP */

#if defined(CONFIG_USB_DEVICE_STACK)
int init_usb(void);
#else
static inline int init_usb(void)
{
	return 0;
}
#endif /* CONFIG_USB_DEVICE_STACK */
```

## include/defines.h
```c
#ifndef DEFINES_H_
#define DEFINES_H_

#include <nrf52840.h>

#define DFU_MODE (0x57)
#define DFU_OTA_MODE (0xA8)
#define DFU_SERIAL_MODE (0x4e)
#define BOOTLOADER_MAGIC_VALUE (0xf01669ef)

inline boot_into_dfu(uint8_t dfu_mode)
{
    NRF_POWER->GPREGRET = dfu_mode;
    NVIC_SystemReset();
}

#endif
```

## include/echo_server.h
```c
#ifndef _ECHO_SERVER_H_
#define _ECHO_SERVER_H_

int start_echo_server(void);

#endif
```

## src/connectionManagement.c
```c
#include "connectionManagement.h"

// int cm_get_next_free_object_index(connection_map *cm)
// {
//     for(int i = 0; i < cm->size; i++)
//     {
//         if(cm->entry[i].connection == NULL)
//         {
//             return i;
//         }
//     }

//     return -1;
// }

// int cm_remove_object_with_index(connection_map *cm, int index)
// {
//     if(cm->size < index)
//     {
//         return -1;
//     }

//     cm->entry[index].connection = NULL;

//     return 0;
// }

// int cm_remove_object_with_addr(connection_map *cm, char addr[BT_ADDR_STR_LEN])
// {
//     for(int i = 0; i < cm->size; i++)
//     {
//         if(strcmp(addr, cm->entry[i].addr) == 0)
//         {
//             cm->entry[i].connection = NULL;

//             return 0;
//         }
//     }

//     return -1;
// }

// int cm_add_object(connection_map *cm, connection_entry entry)
// {
//     int index = cm_get_next_free_object_index(cm);

//     if(index < 0)
//     {
//         return -1;
//     }

//     memcpy(&cm->entry[index], &entry, sizeof(connection_entry));

//     return 0;
// }
```

## src/connectionManagement.cpp
```c
#include "connectionManagement.hpp"

#include <zephyr/bluetooth/bluetooth.h>
#include <vector>
#include <map>
#include <string>

std::map<std::string, struct bt_conn *> connections;
std::map<std::string, struct bt_conn *>::iterator iterator;

int cm_add_entry(char addr[BT_ADDR_STR_LEN], struct bt_conn *conn)
{
    connections.emplace(std::string(addr), conn);

    return 0;
}

int cm_delete_entry(char addr[BT_ADDR_LE_STR_LEN])
{
    iterator = connections.find(std::string(addr));

    connections.erase(iterator);

    return 0;
}

struct bt_conn *cm_get_conn(char addr[BT_ADDR_LE_STR_LEN])
{
    return connections[std::string(addr)];
}
```

## src/connectionManagement.h
```c
#ifndef CONNECTION_MANAGEMENT_H_
#define CONNECTION_MANAGEMENT_H_

#include <zephyr/bluetooth/bluetooth.h>

// typedef struct {
//     char addr[BT_ADDR_STR_LEN];
// 	struct bt_conn *connection;
// } connection_entry;

// typedef struct {
// 	connection_entry *entry;
//     int size;
// } connection_map;

/*
#define CONNECTION_MAP_INIT(name, size) \
    connection_entry name_entries[size]; \
    connection_map name = { \
        .entry = name_entries, \
        .size = size \
    };
*/

// int cm_get_next_free_object_index(connection_map *cm);
// int cm_remove_object_with_index(connection_map *cm, int index);
// int cm_remove_object_with_addr(connection_map *cm, char addr[BT_ADDR_STR_LEN]);
// int cm_add_object(connection_map *cm, connection_entry entry);

#endif
```

## src/connectionManagement.hpp
```c
#ifndef CONNECTION_MANAGEMENT_HPP_
#define CONNECTION_MANAGEMENT_HPP_

#endif
```

## src/connectionManager.c
```c
#include "connectionManager.h"

int cm_get_next_free_object_index(connection_map *cm)
{
    for(int i = 0; i < cm->size; i++)
    {
        if(cm->entry[i].connection == NULL)
        {
            return i;
        }
    }

    return -1;
}

int cm_remove_object_with_index(connection_map *cm, int index)
{
    if(cm->size < index)
    {
        return -1;
    }

    cm->entry[index].connection = NULL;

    return 0;
}

int cm_remove_object_with_addr(connection_map *cm, char addr[BT_ADDR_LE_STR_LEN])
{
    for(int i = 0; i < cm->size; i++)
    {
        if(strcmp(addr, cm->entry[i].addr) == 0)
        {
            cm->entry[i].connection = NULL;

            return 0;
        }
    }

    return -1;
}

int cm_add_object(connection_map *cm, connection_entry entry)
{
    int index = cm_get_next_free_object_index(cm);

    if(index < 0)
    {
        return -1;
    }

    memcpy(&cm->entry[index], &entry, sizeof(connection_entry));

    return 0;
}

int cm_get_index_with_addr(connection_map *cm, char addr[BT_ADDR_LE_STR_LEN])
{
    for(int i = 0; i < cm->size; i++)
    {
        if(strcmp(addr, cm->entry[i].addr) == 0)
        {
            return i;
        }
    }

    return -1;
}

int cm_get_index_with_conn(connection_map *cm, struct bt_conn *conn)
{
    char addr[BT_ADDR_LE_STR_LEN];
    bt_addr_le_to_str(bt_conn_get_dst(conn), addr, BT_ADDR_LE_STR_LEN);

    for(int i = 0; i < cm->size; i++)
    {
        if(strcmp(addr, cm->entry[i].addr) == 0)
        {
            return i;
        }
    }

    return -1;
}
```

## src/connectionManager.h
```c
#ifndef CONNECTION_MANAGER_H_
#define CONNECTION_MANAGER_H_

#include <zephyr/bluetooth/bluetooth.h>
#include <zephyr/bluetooth/gatt.h>

typedef struct {
    char addr[BT_ADDR_LE_STR_LEN];
	struct bt_conn *connection;
    struct bt_gatt_subscribe_params sub_params;
    struct bt_gatt_write_params write_params;
    uint64_t debug_counter;
    uint64_t debug_data_counter;
} connection_entry;

typedef struct {
	connection_entry *entry;
    int size;
} connection_map;

#define CONNECTION_MAP_INIT(name, amount) \
    connection_entry name##entry[amount] = {0} ; \
    connection_map name = { \
        .entry = name##entry, \
        .size = amount, \
    };

int cm_get_next_free_object_index(connection_map *cm);
int cm_remove_object_with_index(connection_map *cm, int index);
int cm_remove_object_with_addr(connection_map *cm, char addr[BT_ADDR_LE_STR_LEN]);
int cm_add_object(connection_map *cm, connection_entry entry);
int cm_get_index_with_addr(connection_map *cm, char addr[BT_ADDR_LE_STR_LEN]);
int cm_get_index_with_conn(connection_map *cm, struct bt_conn *conn);

#endif
```

## src/echo_server.c
```c
/* echo-server.c - Networking echo server */

/*
 * Copyright (c) 2016 Intel Corporation.
 * Copyright (c) 2018 Nordic Semiconductor ASA.
 *
 * SPDX-License-Identifier: Apache-2.0
 */

#include <zephyr/logging/log.h>
LOG_MODULE_REGISTER(net_echo_server_sample, LOG_LEVEL_DBG);

#include <zephyr/kernel.h>
#include <zephyr/linker/sections.h>
#include <errno.h>
#include <zephyr/shell/shell.h>

#include <zephyr/net/net_core.h>
#include <zephyr/net/tls_credentials.h>

#include <zephyr/net/net_mgmt.h>
#include <zephyr/net/net_event.h>
#include <zephyr/net/conn_mgr_monitor.h>

#include "common.h"
#include "echo_server.h"
// #include "certificate.h"

#define APP_BANNER "Run echo server"

static struct k_sem quit_lock;
static struct net_mgmt_event_callback mgmt_cb;
static bool connected;
K_SEM_DEFINE(run_app, 0, 1);
static bool want_to_quit;

#if defined(CONFIG_USERSPACE)
K_APPMEM_PARTITION_DEFINE(app_partition);
struct k_mem_domain app_domain;
#endif

#define EVENT_MASK (NET_EVENT_L4_CONNECTED | \
		    NET_EVENT_L4_DISCONNECTED)

APP_DMEM struct configs conf = {
	.ipv4 = {
		.proto = "IPv4",
	},
	.ipv6 = {
		.proto = "IPv6",
	},
};

void quit(void)
{
	k_sem_give(&quit_lock);
}

static void start_udp_and_tcp(void)
{
	LOG_INF("Starting...");

	// if (IS_ENABLED(CONFIG_NET_TCP)) {
	// 	start_tcp();
	// }

	if (IS_ENABLED(CONFIG_NET_UDP)) {
		start_udp();
	}
}

static void stop_udp_and_tcp(void)
{
	LOG_INF("Stopping...");

	if (IS_ENABLED(CONFIG_NET_UDP)) {
		stop_udp();
	}

	// if (IS_ENABLED(CONFIG_NET_TCP)) {
	// 	stop_tcp();
	// }
}

static void event_handler(struct net_mgmt_event_callback *cb,
			  uint32_t mgmt_event, struct net_if *iface)
{
	ARG_UNUSED(iface);
	ARG_UNUSED(cb);

	if ((mgmt_event & EVENT_MASK) != mgmt_event) {
		return;
	}

	if (want_to_quit) {
		k_sem_give(&run_app);
		want_to_quit = false;
	}

	if (mgmt_event == NET_EVENT_L4_CONNECTED) {
		LOG_INF("Network connected");

		connected = true;
		k_sem_give(&run_app);

		return;
	}

	if (mgmt_event == NET_EVENT_L4_DISCONNECTED) {
		if (connected == false) {
			LOG_INF("Waiting network to be connected");
		} else {
			LOG_INF("Network disconnected");
			connected = false;
		}

		k_sem_reset(&run_app);

		return;
	}
}

static void init_app(void)
{
#if defined(CONFIG_USERSPACE)
	struct k_mem_partition *parts[] = {
#if Z_LIBC_PARTITION_EXISTS
		&z_libc_partition,
#endif
		&app_partition
	};

	int ret = k_mem_domain_init(&app_domain, ARRAY_SIZE(parts), parts);

	__ASSERT(ret == 0, "k_mem_domain_init() failed %d", ret);
	ARG_UNUSED(ret);
#endif

	k_sem_init(&quit_lock, 0, K_SEM_MAX_LIMIT);

	LOG_INF(APP_BANNER);

#if defined(CONFIG_NET_SOCKETS_SOCKOPT_TLS)
	int err;

#if defined(CONFIG_NET_SAMPLE_CERTS_WITH_SC)
	err = tls_credential_add(SERVER_CERTIFICATE_TAG,
				 TLS_CREDENTIAL_CA_CERTIFICATE,
				 ca_certificate,
				 sizeof(ca_certificate));
	if (err < 0) {
		LOG_ERR("Failed to register CA certificate: %d", err);
	}
#endif /* defined(CONFIG_NET_SAMPLE_CERTS_WITH_SC) */

	err = tls_credential_add(SERVER_CERTIFICATE_TAG,
				 TLS_CREDENTIAL_SERVER_CERTIFICATE,
				 server_certificate,
				 sizeof(server_certificate));
	if (err < 0) {
		LOG_ERR("Failed to register public certificate: %d", err);
	}


	err = tls_credential_add(SERVER_CERTIFICATE_TAG,
				 TLS_CREDENTIAL_PRIVATE_KEY,
				 private_key, sizeof(private_key));
	if (err < 0) {
		LOG_ERR("Failed to register private key: %d", err);
	}

#if defined(CONFIG_MBEDTLS_KEY_EXCHANGE_PSK_ENABLED)
	err = tls_credential_add(PSK_TAG,
				TLS_CREDENTIAL_PSK,
				psk,
				sizeof(psk));
	if (err < 0) {
		LOG_ERR("Failed to register PSK: %d", err);
	}
	err = tls_credential_add(PSK_TAG,
				TLS_CREDENTIAL_PSK_ID,
				psk_id,
				sizeof(psk_id) - 1);
	if (err < 0) {
		LOG_ERR("Failed to register PSK ID: %d", err);
	}
#endif /* defined(CONFIG_MBEDTLS_KEY_EXCHANGE_PSK_ENABLED) */
#endif /* defined(CONFIG_NET_SOCKETS_SOCKOPT_TLS) */

	if (IS_ENABLED(CONFIG_NET_CONNECTION_MANAGER)) {
		net_mgmt_init_event_callback(&mgmt_cb,
					     event_handler, EVENT_MASK);
		net_mgmt_add_event_callback(&mgmt_cb);

		conn_mgr_mon_resend_status();
	}

	init_vlan();
	init_tunnel();

	init_usb();
}

static int cmd_sample_quit(const struct shell *sh,
			  size_t argc, char *argv[])
{
	want_to_quit = true;

	conn_mgr_mon_resend_status();

	quit();

	return 0;
}

SHELL_STATIC_SUBCMD_SET_CREATE(sample_commands,
	SHELL_CMD(quit, NULL,
		  "Quit the sample application\n",
		  cmd_sample_quit),
	SHELL_SUBCMD_SET_END
);

SHELL_CMD_REGISTER(sample, &sample_commands,
		   "Sample application commands", NULL);

int start_echo_server(void)
{
	init_app();

	if (!IS_ENABLED(CONFIG_NET_CONNECTION_MANAGER)) {
		/* If the config library has not been configured to start the
		 * app only after we have a connection, then we can start
		 * it right away.
		 */
		k_sem_give(&run_app);
	}

	/* Wait for the connection. */
	k_sem_take(&run_app, K_FOREVER);

	start_udp_and_tcp();

	k_sem_take(&quit_lock, K_FOREVER);

	if (connected) {
		stop_udp_and_tcp();
	}
	return 0;
}
```

## src/udp.c
```c
/* udp.c - UDP specific code for echo server */

/*
 * Copyright (c) 2017 Intel Corporation.
 * Copyright (c) 2018 Nordic Semiconductor ASA.
 *
 * SPDX-License-Identifier: Apache-2.0
 */

#include <zephyr/logging/log.h>
LOG_MODULE_DECLARE(net_echo_server_sample, LOG_LEVEL_DBG);

#include <zephyr/kernel.h>
#include <errno.h>
#include <stdio.h>

#include <zephyr/net/socket.h>
#include <zephyr/net/tls_credentials.h>

#include "common.h"
// #include "certificate.h"

static void process_udp4(void);
static void process_udp6(void);

K_THREAD_DEFINE(udp4_thread_id, STACK_SIZE,
		process_udp4, NULL, NULL, NULL,
		THREAD_PRIORITY,
		IS_ENABLED(CONFIG_USERSPACE) ? K_USER : 0, -1);

K_THREAD_DEFINE(udp6_thread_id, STACK_SIZE,
		process_udp6, NULL, NULL, NULL,
		THREAD_PRIORITY,
		IS_ENABLED(CONFIG_USERSPACE) ? K_USER : 0, -1);

static int start_udp_proto(struct data *data, struct sockaddr *bind_addr,
			   socklen_t bind_addrlen)
{
	int optval;
	int ret;

#if defined(CONFIG_NET_SOCKETS_SOCKOPT_TLS)
	data->udp.sock = socket(bind_addr->sa_family, SOCK_DGRAM,
				IPPROTO_DTLS_1_2);
#else
	data->udp.sock = socket(bind_addr->sa_family, SOCK_DGRAM, IPPROTO_UDP);
#endif
	if (data->udp.sock < 0) {
		NET_ERR("Failed to create UDP socket (%s): %d", data->proto,
			errno);
		return -errno;
	}

#if defined(CONFIG_NET_SOCKETS_SOCKOPT_TLS)
	sec_tag_t sec_tag_list[] = {
		SERVER_CERTIFICATE_TAG,
#if defined(CONFIG_MBEDTLS_KEY_EXCHANGE_PSK_ENABLED)
		PSK_TAG,
#endif
	};
	int role = TLS_DTLS_ROLE_SERVER;

	ret = setsockopt(data->udp.sock, SOL_TLS, TLS_SEC_TAG_LIST,
			 sec_tag_list, sizeof(sec_tag_list));
	if (ret < 0) {
		NET_ERR("Failed to set UDP secure option (%s): %d", data->proto,
			errno);
		ret = -errno;
	}

	/* Set role to DTLS server. */
	ret = setsockopt(data->udp.sock, SOL_TLS, TLS_DTLS_ROLE,
			 &role, sizeof(role));
	if (ret < 0) {
		NET_ERR("Failed to set DTLS role secure option (%s): %d",
			data->proto, errno);
		ret = -errno;
	}
#endif

    //TODO: CHECK THIS
	if (bind_addr->sa_family == AF_INET6) {
		/* Prefer IPv6 temporary addresses */
		// optval = IPV6_PREFER_SRC_PUBLIC;
		// (void)setsockopt(data->tcp.sock, IPPROTO_IPV6,
		// 		 IPV6_ADDR_PREFERENCES,
		// 		 &optval, sizeof(optval));

		/*
		 * Bind only to IPv6 without mapping to IPv4, since we bind to
		 * IPv4 using another socket
		 */
		optval = 1;
		(void)setsockopt(data->tcp.sock, IPPROTO_IPV6, IPV6_V6ONLY,
				 &optval, sizeof(optval));
	}

	ret = bind(data->udp.sock, bind_addr, bind_addrlen);
	if (ret < 0) {
		NET_ERR("Failed to bind UDP socket (%s): %d", data->proto,
			errno);
		ret = -errno;
	}

	return ret;
}

static int process_udp(struct data *data)
{
	int ret = 0;
	int received;
	struct sockaddr client_addr;
	socklen_t client_addr_len;

	NET_INFO("Waiting for UDP packets on port %d (%s)...",
		 MY_PORT, data->proto);

	do {
		client_addr_len = sizeof(client_addr);
		received = recvfrom(data->udp.sock, data->udp.recv_buffer,
				    sizeof(data->udp.recv_buffer), 0,
				    &client_addr, &client_addr_len);

		if (received < 0) {
			/* Socket error */
			NET_ERR("UDP (%s): Connection error %d", data->proto,
				errno);
			ret = -errno;
			break;
		} else if (received) {
			atomic_add(&data->udp.bytes_received, received);
		}

		ret = sendto(data->udp.sock, data->udp.recv_buffer, received, 0,
			     &client_addr, client_addr_len);
		if (ret < 0) {
			NET_ERR("UDP (%s): Failed to send %d", data->proto,
				errno);
			ret = -errno;
			break;
		}

		if (++data->udp.counter % 1000 == 0U) {
			NET_INFO("%s UDP: Sent %u packets", data->proto,
				 data->udp.counter);
		}

		NET_DBG("UDP (%s): Received and replied with %d bytes",
			data->proto, received);
	} while (true);

	return ret;
}

static void process_udp4(void)
{
	int ret;
	struct sockaddr_in addr4;

	(void)memset(&addr4, 0, sizeof(addr4));
	addr4.sin_family = AF_INET;
	addr4.sin_port = htons(MY_PORT);

	ret = start_udp_proto(&conf.ipv4, (struct sockaddr *)&addr4,
			      sizeof(addr4));
	if (ret < 0) {
		quit();
		return;
	}

	while (ret == 0) {
		ret = process_udp(&conf.ipv4);
		if (ret < 0) {
			quit();
		}
	}
}

static void process_udp6(void)
{
	int ret;
	struct sockaddr_in6 addr6;

	(void)memset(&addr6, 0, sizeof(addr6));
	addr6.sin6_family = AF_INET6;
	addr6.sin6_port = htons(MY_PORT);

	ret = start_udp_proto(&conf.ipv6, (struct sockaddr *)&addr6,
			      sizeof(addr6));
	if (ret < 0) {
		quit();
		return;
	}

	while (ret == 0) {
		ret = process_udp(&conf.ipv6);
		if (ret < 0) {
			quit();
		}
	}
}

static void print_stats(struct k_work *work)
{
	struct k_work_delayable *dwork = k_work_delayable_from_work(work);
	struct data *data = CONTAINER_OF(dwork, struct data, udp.stats_print);
	int total_received = atomic_get(&data->udp.bytes_received);

	if (total_received) {
		if ((total_received / STATS_TIMER) < 1024) {
			LOG_INF("%s UDP: Received %d B/sec", data->proto,
				total_received / STATS_TIMER);
		} else {
			LOG_INF("%s UDP: Received %d KiB/sec", data->proto,
				total_received / 1024 / STATS_TIMER);
		}

		atomic_set(&data->udp.bytes_received, 0);
	}

	k_work_reschedule(&data->udp.stats_print, K_SECONDS(STATS_TIMER));
}

void start_udp(void)
{
	if (IS_ENABLED(CONFIG_NET_IPV6)) {
#if defined(CONFIG_USERSPACE)
		k_mem_domain_add_thread(&app_domain, udp6_thread_id);
#endif

		k_work_init_delayable(&conf.ipv6.udp.stats_print, print_stats);
		k_thread_name_set(udp6_thread_id, "udp6");
		k_thread_start(udp6_thread_id);
		k_work_reschedule(&conf.ipv6.udp.stats_print,
				  K_SECONDS(STATS_TIMER));
	}

	if (IS_ENABLED(CONFIG_NET_IPV4)) {
#if defined(CONFIG_USERSPACE)
		k_mem_domain_add_thread(&app_domain, udp4_thread_id);
#endif

		k_work_init_delayable(&conf.ipv4.udp.stats_print, print_stats);
		k_thread_name_set(udp4_thread_id, "udp4");
		k_thread_start(udp4_thread_id);
		k_work_reschedule(&conf.ipv4.udp.stats_print,
				  K_SECONDS(STATS_TIMER));
	}
}

void stop_udp(void)
{
	/* Not very graceful way to close a thread, but as we may be blocked
	 * in recvfrom call it seems to be necessary
	 */
	if (IS_ENABLED(CONFIG_NET_IPV6)) {
		k_thread_abort(udp6_thread_id);
		if (conf.ipv6.udp.sock >= 0) {
			(void)close(conf.ipv6.udp.sock);
		}
	}

	if (IS_ENABLED(CONFIG_NET_IPV4)) {
		k_thread_abort(udp4_thread_id);
		if (conf.ipv4.udp.sock >= 0) {
			(void)close(conf.ipv4.udp.sock);
		}
	}
}
```

## src/usb.c
```c
/*
 * Copyright (c) 2021 TiaC Systems
 *
 * SPDX-License-Identifier: Apache-2.0
 */

#include <zephyr/logging/log.h>
LOG_MODULE_DECLARE(net_echo_server_sample, LOG_LEVEL_DBG);

#include <zephyr/usb/usb_device.h>
#include <zephyr/net/net_config.h>

int init_usb(void)
{
	int ret;

	ret = usb_enable(NULL);
	if (ret != 0) {
		LOG_ERR("Cannot enable USB (%d)", ret);
		return ret;
	}

	(void)net_config_init_app(NULL, "Initializing network");

	return 0;
}
```
